## CMakeLists.txt
```
cmake_minimum_required(VERSION 3.13.1)

get_filename_component(PARENT_DIR ${CMAKE_SOURCE_DIR} DIRECTORY)
set(ZEPHYR_EXTRA_MODULES ${PARENT_DIR} ${PARENT_DIR}/cozy)
include($ENV{ZEPHYR_BASE}/cmake/app/boilerplate.cmake NO_POLICY_SCOPE)

project(suit_test)
FILE(GLOB app_sources src/*.c)
target_sources(app PRIVATE ${app_sources})
```

## prj.conf
```kconfig
CONFIG_ZOOT=y
CONFIG_ZTEST=y
CONFIG_ZTEST_STACKSIZE=4096
CONFIG_MBEDTLS_HEAP_SIZE=16384
CONFIG_PRINTK=y
```

## src/main.c
```c
/*
 * Copyright 2020 RISE Research Institutes of Sweden
 *
 * Licensed under the Apache License, Version 2.0 (the "License");
 * you may not use this file except in compliance with the License.
 * You may obtain a copy of the License at
 * 
 *   http://www.apache.org/licenses/LICENSE-2.0
 * 
 * Unless required by applicable law or agreed to in writing,
 * software distributed under the License is distributed on an
 * "AS IS" BASIS, WITHOUT WARRANTIES OR CONDITIONS OF ANY
 * KIND, either express or implied.  See the License for the
 * specific language governing permissions and limitations
 * under the License.
 */

#include <ztest.h>

extern void test_suit_boot(void);
extern void test_suit_download_install(void);
extern void test_suit_download_install_boot(void);
extern void test_suit_load_external_storage(void);
extern void test_suit_load_decompress_external_storage(void);
extern void test_suit_compatibility_download_install_boot(void);
extern void test_suit_two_images(void);

/* test case main entry */
void test_main(void)
{
    ztest_test_suite(suit_tests,
        ztest_unit_test(test_suit_boot),
        ztest_unit_test(test_suit_download_install),
        ztest_unit_test(test_suit_download_install_boot),
        ztest_unit_test(test_suit_load_external_storage),
        ztest_unit_test(test_suit_load_decompress_external_storage),
        ztest_unit_test(test_suit_compatibility_download_install_boot),
        ztest_unit_test(test_suit_two_images));
    ztest_run_test_suite(suit_tests);
}
```

## src/tests.c
```c
/*
 * Copyright 2020 RISE Research Institutes of Sweden
 *
 * Licensed under the Apache License, Version 2.0 (the "License");
 * you may not use this file except in compliance with the License.
 * You may obtain a copy of the License at
 * 
 *   http://www.apache.org/licenses/LICENSE-2.0
 * 
 * Unless required by applicable law or agreed to in writing,
 * software distributed under the License is distributed on an
 * "AS IS" BASIS, WITHOUT WARRANTIES OR CONDITIONS OF ANY
 * KIND, either express or implied.  See the License for the
 * specific language governing permissions and limitations
 * under the License.
 */

#include <ztest.h>
#include <zoot/suit.h>
#include "vectors.h"

static size_t test_size = 34768;
static uint8_t test_digest[] = {
    0x00, 0x11, 0x22, 0x33, 0x44, 0x55, 0x66, 0x77,
    0x88, 0x99, 0xaa, 0xbb, 0xcc, 0xdd, 0xee, 0xff,
    0x01, 0x23, 0x45, 0x67, 0x89, 0xab, 0xcd, 0xef,
    0xfe, 0xdc, 0xba, 0x98, 0x76, 0x54, 0x32, 0x10
};
static uint8_t test_vendor_id[] = {
    0xfa, 0x6b, 0x4a, 0x53, 0xd5, 0xad, 0x5f, 0xdf,
    0xbe, 0x9d, 0xe6, 0x63, 0xe4, 0xd4, 0x1f, 0xfe
};
static uint8_t test_class_id[] = {
    0x14, 0x92, 0xaf, 0x14, 0x25, 0x69, 0x5e, 0x48,
    0xbf, 0x42, 0x9b, 0x2d, 0x51, 0xf2, 0xab, 0x45
};
static uint8_t test_uri[] = {
    'h', 't', 't', 'p', ':', '/', '/', 'e', 
    'x', 'a', 'm', 'p', 'l', 'e', '.', 'c', 
    'o', 'm', '/', 'f', 'i', 'l', 'e', '.', 
    'b', 'i', 'n'
};

#define SUIT_TEST_PARSE(x)                                              \
    size_t len_man = strlen(SUIT_MANIFEST_##x) / 2;                     \
    uint8_t man[len_man];                                               \
    _xxd_r(SUIT_MANIFEST_##x, man);                                     \
    suit_context_t ctx;                                                 \
    zassert_false(suit_parse_init(&ctx, man, len_man),                  \
            "Failed to parse SUIT manifest.");

/* converts hex-formatted IETF examples to raw bytes */
void _xxd_r(char * hex, uint8_t * out)
{
    size_t len_hex = strlen(hex);
    uint8_t buf[5] = {'0', 'x', 0, 0, 0};
    for (int i = 0; i < len_hex / 2; i++) {
        buf[2] = hex[i]; buf[3] = hex[i+1];
        out[i] = strtol(buf, NULL, 0);
        hex++;
    } 
}

const uint8_t * pem_pub = SUIT_TEST_KEY_256_PUB;
const uint8_t * pem_prv = SUIT_TEST_KEY_256_PRV;

void test_suit_boot(void) {
    SUIT_TEST_PARSE(0);

    /* encode a signed manifest envelope */
    size_t len_env = 256; uint8_t env[len_env];
    zassert_false(suit_manifest_wrap(
                pem_prv, man, len_man, env, &len_env),
                "Failed to write manifest envelope.");

    /* verify encoded envelope and extract manifest */
    uint8_t * man_out;
    size_t len_man_out;
    zassert_false(suit_manifest_unwrap(
                pem_pub, env, len_env,
                (const uint8_t **) &man_out, &len_man_out),
                "Failed to authenticate envelope contents.");

    /* check that extracted manifest matches the original */
    zassert_true(len_man == len_man_out,
            "Failed to extract manifest.");
    zassert_false(memcmp(man, man_out, len_man),
            "Failed to extract manifest.");
}
 
void test_suit_download_install(void) {
    SUIT_TEST_PARSE(1);
    zassert_true(
            suit_class_id_is_match(&ctx, 0, test_class_id, sizeof(test_class_id)),
            "Class ID mismatch.");
    zassert_true(
            suit_vendor_id_is_match(&ctx, 0, test_vendor_id, sizeof(test_vendor_id)),
            "Vendor ID mismatch.");
    zassert_true(
            suit_digest_is_match(&ctx, 0, test_digest, sizeof(test_digest)),
            "Image digest mismatch.");

    uint8_t * uri; size_t len_uri;
    suit_get_uri(&ctx, 0, (const uint8_t **) &uri, &len_uri);
    zassert_false(memcmp(test_uri, uri, len_uri), "Unexpected URI.");

    zassert_true(suit_get_size(&ctx, 0) == test_size, "Unexpeted image size.");
    zassert_false(suit_must_run(&ctx, 0), "Unexpected run directive.");
}

void test_suit_download_install_boot(void) {
    SUIT_TEST_PARSE(2);
    zassert_true(
            suit_class_id_is_match(&ctx, 0, test_class_id, sizeof(test_class_id)),
            "Class ID mismatch.");
    zassert_true(
            suit_vendor_id_is_match(&ctx, 0, test_vendor_id, sizeof(test_vendor_id)),
            "Vendor ID mismatch.");
    zassert_true(
            suit_digest_is_match(&ctx, 0, test_digest, sizeof(test_digest)),
            "Image digest mismatch.");

    uint8_t * uri; size_t len_uri;
    suit_get_uri(&ctx, 0, (const uint8_t **) &uri, &len_uri);
    zassert_false(memcmp(test_uri, uri, len_uri), "Unexpected URI.");

    zassert_true(suit_get_size(&ctx, 0) == test_size, "Unexpeted image size.");
    zassert_true(suit_must_run(&ctx, 0), "Unexpected run directive.");
}

void test_suit_load_external_storage(void) {
    SUIT_TEST_PARSE(3);
    zassert_true(
            suit_class_id_is_match(&ctx, 0, test_class_id, sizeof(test_class_id)),
            "Class ID mismatch.");
    zassert_true(
            suit_vendor_id_is_match(&ctx, 0, test_vendor_id, sizeof(test_vendor_id)),
            "Vendor ID mismatch.");
    zassert_true(
            suit_digest_is_match(&ctx, 0, test_digest, sizeof(test_digest)),
            "Image digest mismatch.");
    zassert_true(
            suit_get_source_component(&ctx, 1) == &ctx.components[0],
            "Unexpected source component.");

    uint8_t * uri; size_t len_uri;
    suit_get_uri(&ctx, 0, (const uint8_t **) &uri, &len_uri);
    zassert_false(memcmp(test_uri, uri, len_uri), "Unexpected URI.");

    zassert_true(suit_get_size(&ctx, 0) == test_size, "Unexpeted image size.");
    zassert_false(suit_must_run(&ctx, 0), "Unexpected run directive.");
    zassert_true(suit_must_run(&ctx, 1), "Unexpected run directive.");
}

void test_suit_load_decompress_external_storage(void) {
    SUIT_TEST_PARSE(4);
    zassert_true(
            suit_class_id_is_match(&ctx, 0, test_class_id, sizeof(test_class_id)),
            "Class ID mismatch.");
    zassert_true(
            suit_vendor_id_is_match(&ctx, 0, test_vendor_id, sizeof(test_vendor_id)),
            "Vendor ID mismatch.");
    zassert_true(
            suit_digest_is_match(&ctx, 0, test_digest, sizeof(test_digest)),
            "Image digest mismatch.");
    zassert_true(
            suit_get_source_component(&ctx, 1) == &ctx.components[0],
            "Unexpected source component.");

    uint8_t * uri; size_t len_uri;
    suit_get_uri(&ctx, 0, (const uint8_t **) &uri, &len_uri);
    zassert_false(memcmp(test_uri, uri, len_uri), "Unexpected URI.");

    zassert_true(suit_get_size(&ctx, 0) == test_size, "Unexpeted image size.");
    zassert_false(suit_must_run(&ctx, 0), "Unexpected run directive.");
    zassert_true(suit_must_run(&ctx, 1), "Unexpected run directive.");
}

void test_suit_compatibility_download_install_boot(void) {
    SUIT_TEST_PARSE(5);
    zassert_true(
            suit_class_id_is_match(&ctx, 1, test_class_id, sizeof(test_class_id)),
            "Class ID mismatch.");
    zassert_true(
            suit_vendor_id_is_match(&ctx, 1, test_vendor_id, sizeof(test_vendor_id)),
            "Vendor ID mismatch.");
    zassert_true(
            suit_digest_is_match(&ctx, 1, test_digest, sizeof(test_digest)),
            "Image digest mismatch.");
    zassert_true(
            suit_get_source_component(&ctx, 1) == &ctx.components[0],
            "Unexpected source component.");

    uint8_t * uri; size_t len_uri;
    suit_get_uri(&ctx, 0, (const uint8_t **) &uri, &len_uri);
    zassert_false(memcmp(test_uri, uri, len_uri), "Unexpected URI.");

    zassert_true(suit_get_size(&ctx, 1) == test_size, "Unexpeted image size.");
    zassert_false(suit_must_run(&ctx, 0), "Unexpected run directive.");
    zassert_true(suit_must_run(&ctx, 1), "Unexpected run directive.");
}

void test_suit_two_images(void) {
    SUIT_TEST_PARSE(6);
    zassert_true(
            suit_class_id_is_match(&ctx, 0, test_class_id, sizeof(test_class_id)),
            "Class ID mismatch.");
    zassert_true(
            suit_vendor_id_is_match(&ctx, 0, test_vendor_id, sizeof(test_vendor_id)),
            "Vendor ID mismatch.");
    zassert_true(
            suit_digest_is_match(&ctx, 0, test_digest, sizeof(test_digest)),
            "Image digest mismatch.");

    zassert_true(suit_get_size(&ctx, 0) == test_size, "Unexpeted image size.");
    zassert_false(suit_must_run(&ctx, 0), "Unexpected run directive.");

    uint8_t test_uri_[] = {
        'h', 't', 't', 'p', ':', '/', '/', 'e', 
        'x', 'a', 'm', 'p', 'l', 'e', '.', 'c', 
        'o', 'm', '/', 'f', 'i', 'l', 'e', '1',
        '.', 'b', 'i', 'n'
    };
    
    uint8_t * uri; size_t len_uri;
    suit_get_uri(&ctx, 0, (const uint8_t **) &uri, &len_uri);
    zassert_false(memcmp(test_uri_, uri, len_uri), "Unexpected URI.");
}
```

## src/vectors.h
```c
/*
 * Copyright 2020 RISE Research Institutes of Sweden
 *
 * Licensed under the Apache License, Version 2.0 (the "License");
 * you may not use this file except in compliance with the License.
 * You may obtain a copy of the License at
 * 
 *   http://www.apache.org/licenses/LICENSE-2.0
 * 
 * Unless required by applicable law or agreed to in writing,
 * software distributed under the License is distributed on an
 * "AS IS" BASIS, WITHOUT WARRANTIES OR CONDITIONS OF ANY
 * KIND, either express or implied.  See the License for the
 * specific language governing permissions and limitations
 * under the License.
 */

#define SUIT_TEST_KEY_256_PRV                                                   \
    "-----BEGIN PRIVATE KEY-----\r\n"                                           \
    "MIGHAgEAMBMGByqGSM49AgEGCCqGSM49AwEHBG0wawIBAQQgApZYjZCUGLM50VBC\r\n"      \
    "CjYStX+09jGmnyJPrpDLTz/hiXOhRANCAASEloEarguqq9JhVxie7NomvqqL8Rtv\r\n"      \
    "P+bitWWchdvArTsfKktsCYExwKNtrNHXi9OB3N+wnAUtszmR23M4tKiW\r\n"              \
    "-----END PRIVATE KEY-----\r\n"

#define SUIT_TEST_KEY_256_PUB                                                   \
    "-----BEGIN PUBLIC KEY-----\r\n"                                            \
    "MFkwEwYHKoZIzj0CAQYIKoZIzj0DAQcDQgAEhJaBGq4LqqvSYVcYnuzaJr6qi/Eb\r\n"      \
    "bz/m4rVlnIXbwK07HypLbAmBMcCjbazR14vTgdzfsJwFLbM5kdtzOLSolg==\r\n"          \
    "-----END PUBLIC KEY-----\r\n"

/*
 * These examples can be found at:
 * https://tools.ietf.org/html/draft-ietf-suit-manifest-04#section-12
 */
#define SUIT_MANIFEST_0                                                         \
    "a50101020103585ea20244818141000458548614a40150fa6"                         \
    "b4a53d5ad5fdfbe9de663e4d41ffe02501492af1425695e48bf429b2d51f2ab4503820"    \
    "2582000112233445566778899aabbccddeeff0123456789abcdeffedcba98765432100"    \
    "e1987d001f602f60a438203f60c438217f6"

#define SUIT_MANIFEST_1                                                         \
    "a50101020203585ea20244818141000458548614a40150fa6"                         \
    "b4a53d5ad5fdfbe9de663e4d41ffe02501492af1425695e48bf429b2d51f2ab4503820"    \
    "2582000112233445566778899aabbccddeeff0123456789abcdeffedcba98765432100"    \
    "e1987d001f602f60958258613a115781b687474703a2f2f6578616d706c652e636f6d2"    \
    "f66696c652e62696e15f603f60a438203f6"

#define SUIT_MANIFEST_2                                                         \
    "a60101020303585ea20244818141000458548614a40150fa6"                         \
    "b4a53d5ad5fdfbe9de663e4d41ffe02501492af1425695e48bf429b2d51f2ab4503820"    \
    "2582000112233445566778899aabbccddeeff0123456789abcdeffedcba98765432100"    \
    "e1987d001f602f60958258613a115781b687474703a2f2f6578616d706c652e636f6d2"    \
    "f66696c652e62696e15f603f60a438203f60c438217f6"

#define SUIT_MANIFEST_3                                                         \
    "a701010204035863a2024782814100814101045856880c001"                         \
    "4a40150fa6b4a53d5ad5fdfbe9de663e4d41ffe02501492af1425695e48bf429b2d51f"    \
    "2ab45038202582000112233445566778899aabbccddeeff0123456789abcdeffedcba9"    \
    "8765432100e1987d001f602f6095827880c0013a115781b687474703a2f2f6578616d7"    \
    "06c652e636f6d2f66696c652e62696e15f603f60a45840c0003f60b4b880c0113a1160"    \
    "016f603f60c45840c0117f6"

#define SUIT_MANIFEST_4                                                         \
    "a701010205035863a2024782814100814101045856880c001"                         \
    "4a40150fa6b4a53d5ad5fdfbe9de663e4d41ffe02501492af1425695e48bf429b2d51f"    \
    "2ab45038202582000112233445566778899aabbccddeeff0123456789abcdeffedcba9"    \
    "8765432100e1987d001f602f6095827880c0013a115781b687474703a2f2f6578616d7"    \
    "06c652e636f6d2f66696c652e62696e15f603f60a45840c0003f60b4d880c0113a2130"    \
    "1160016f603f60c45840c0117f6"

#define SUIT_MANIFEST_5                                                         \
    "a701010205035863a2024782814101814100045856880c011"                         \
    "4a40150fa6b4a53d5ad5fdfbe9de663e4d41ffe02501492af1425695e48bf429b2d51f"    \
    "2ab45038202582000112233445566778899aabbccddeeff0123456789abcdeffedcba9"    \
    "8765432100e1987d001f602f6085823840c0013a115781b687474703a2f2f6578616d7"    \
    "06c652e636f6d2f66696c652e62696e094b880c0113a1160016f603f60a45840c0103f"    \
    "60c45840c0117f6"

#define SUIT_MANIFEST_6                                                         \
    "a501010203035899a202448181410004588f8814a20150fa6"                         \
    "b4a53d5ad5fdfbe9de663e4d41ffe02501492af1425695e48bf429b2d51f2ab450f825"    \
    "82e8405f614a2038202582000112233445566778899aabbccddeeff0123456789abcde"    \
    "ffedcba98765432100e1987d058308405f614a203820258200123456789abcdeffedcb"    \
    "a987654321000112233445566778899aabbccddeeff0e1a00012c2201f602f60958538"    \
    "60f8258248405f613a115781c687474703a2f2f6578616d706c652e636f6d2f66696c6"    \
    "5312e62696e58248405f613a115781c687474703a2f2f6578616d706c652e636f6d2f6"    \
    "6696c65322e62696e15f603f60a438203f6"
```
